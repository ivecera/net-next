## Documentation/devicetree/bindings/net/micrel,lan8814-package.yaml
```yaml
# SPDX-License-Identifier: (GPL-2.0-only OR BSD-2-Clause)
%YAML 1.2
---
$id: http://devicetree.org/schemas/net/micrel,lan8814-package.yaml#
$schema: http://devicetree.org/meta-schemas/core.yaml#

title: Micrel LAN8814 Quad-Port Ethernet PHY Package

maintainers:
  - TODO ???

description: |
  The Micrel LAN8814 is a Quad-Port Gigabit Ethernet PHY.
  This binding describes the package container which groups the four
  individual PHYs, allowing for the management of shared resources
  such as the PTP clock, GPIOs, and global configuration registers.

allOf:
  - $ref: ethernet-phy-package.yaml#

properties:
  compatible:
    const: micrel,lan8814-package

  microchip,ptp-clock-frequency-hz:
    description:
      Frequency of the external PTP reference clock in Hertz.
    enum: [ 10000000, 25000000, 125000000 ]

patternProperties:
  ^ethernet-phy(@[a-f0-9]+)?$:
    allOf:
      - $ref: ethernet-phy.yaml#

    unevaluatedProperties: false

required:
  - compatible

unevaluatedProperties: false

examples:
  - |
    mdio {
        #address-cells = <1>;
        #size-cells = <0>;

        ethernet-phy-package@0 {
            compatible = "micrel,lan8814-package";
            reg = <0>;
            #address-cells = <1>;
            #size-cells = <0>;

            microchip,ptp-clock-frequency-hz = <125000000>;

            ethernet-phy@0 {
                reg = <0>;
            };

            ethernet-phy@1 {
                reg = <1>;
            };

            ethernet-phy@2 {
                reg = <2>;
            };

            ethernet-phy@3 {
                reg = <3>;
            };
        };
    };
...
```

## drivers/dpll/Kconfig
```kconfig
# SPDX-License-Identifier: GPL-2.0-only
#
# Generic DPLL drivers configuration
#

menu "DPLL device support"

config DPLL
	bool

config DPLL_REFCNT_TRACKER
	bool "DPLL reference count tracking"
	depends on DEBUG_KERNEL && STACKTRACE_SUPPORT && DPLL
	select REF_TRACKER
	help
	  Enable reference count tracking for DPLL devices and pins.
	  This helps debugging reference leaks and use-after-free bugs
	  by recording stack traces for each get/put operation.

	  The tracking information is exposed via debugfs at:
	    /sys/kernel/debug/ref_tracker/dpll_device_*
	    /sys/kernel/debug/ref_tracker/dpll_pin_*

	  If unsure, say N.

config DPLL_KUNIT_TEST
	tristate "KUnit tests for DPLL core" if !KUNIT_ALL_TESTS
	depends on KUNIT && NET
	select DPLL
	default KUNIT_ALL_TESTS
	help
	  KUnit tests for locking in the DPLL core. They use a mock driver
	  to check that callbacks run under the locks of their domains and
	  that unrelated domains do not block each other. The checks of held
	  locks need PROVE_LOCKING.

	  If unsure, say N.

source "drivers/dpll/zl3073x/Kconfig"

endmenu
```

## drivers/dpll/dpllsim/Kconfig
```kconfig
# SPDX-License-Identifier: GPL-2.0-only
#
# DPLL simulator driver configuration
#

config DPLLSIM
	tristate "Simulated DPLL device"
	depends on DPLL
	help
	  This driver provides a simulated DPLL device for testing
	  and development purposes. It creates a virtual DPLL device
	  with configurable pins that can be controlled through the
	  DPLL subsystem netlink interface.

	  Similar to netdevsim for network devices, dpllsim allows
	  testing DPLL-related code without requiring actual hardware.

	  To compile this driver as a module, choose M here: the module
	  will be called dpllsim.
```
